AUTOSAR XML (schema 00045)
package /ActiveEcuC
  module config vSet: implementation-config-variant=VARIANT-PRE-COMPILE, module-description=vSet_Impl
    vSetGeneral: vSetDummyStatementKind=SelfAssignment
    vSetPlatform:
      vSetBitOrder = LSB_to_MSB
      vSetByteOrder = LITTLE_ENDIAN
      vSetSizeOfRAMPointer = Size32Bit
      vSetSizeOfROMPointer = Size32Bit
      vSetSizeOfInt = Size32Bit
      vSetCPUType = CPU32Bit
      vSetSizeOfEnum = Size32Bit
    vSetCalibration
