AUTOSAR XML (schema 00045)
package /ActiveEcuC
  ecuc value collection ActiveEcuC: ecu-extract=SYSTEM, ecuc-values=[vSet, Rte, Resource, Os, Base, BswM, EcuM, EcuC, Mcu, Det]
