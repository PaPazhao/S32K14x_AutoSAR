AUTOSAR XML (schema 00045)
package /ActiveEcuC
  ecuc value collection ActiveEcuC
