AUTOSAR XML (schema 00045)
package /ActiveEcuC
  module config Resource: implementation-config-variant=VARIANT-PRE-COMPILE
    CommonPublishedInformation:
      ArReleaseMajorVersion = 4
      ArReleaseMinorVersion = 2
      ArReleaseRevisionVersion = 2
      ModuleId = 0
      SwMajorVersion = 1
      SwMinorVersion = 0
      SwPatchVersion = 1
      VendorId = 43
    ResourceGeneral: ResourceSubderivative=s32k146_lqfp144
