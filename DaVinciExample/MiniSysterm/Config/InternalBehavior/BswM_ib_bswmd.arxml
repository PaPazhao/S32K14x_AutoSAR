AUTOSAR XML (schema 4-0-3)
package /MICROSAR/BswM_ib_bswmd/BswModuleDescriptions
  bsw module description BswM: provided-entrys=BswM_MainFunction
    bsw internal behavior BswMBehavior
      exclusive area BSWM_EXCLUSIVE_AREA_0
      bsw schedulable entity BswM_MainFunction: implemented-entry=BswM_MainFunction
      bsw timing event BswM_MainFunctionTimingEvent0: starts-on-event=BswM_MainFunction, period=0.01
  bsw module entry BswM_MainFunction: call-type=SCHEDULED, execution-context=TASK
