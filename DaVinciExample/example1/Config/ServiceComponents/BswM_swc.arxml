AUTOSAR XML (schema 4-2-1)
package /MICROSAR/BswM_swc
  data type mapping set BswMMappingSet  # Contains Mapping for ModeDeclarations Groups which are provided by BswM.
package /MICROSAR/BswM_swc/ComponentTypes
  service sw component type BswM: category=SERVICE_COMPONENT
    behavior BswMInternalBehavior: data-type-mapping=BswMMappingSet, handle-termination-and-restart=NO-SUPPORT
      timing event Timer_BswM_MainFunction: start-on-event=BswM_MainFunction, period=0.01
      runnable BswM_MainFunction
  swc implementation BswMImplementation: programming-language=C, behavior=BswMInternalBehavior
