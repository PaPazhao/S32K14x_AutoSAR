AUTOSAR XML (schema 4-2-1)
package /COM/VECTOR/CFG/WORKFLOW/SYSDESC/SYNC
  flat map FLATMAP
    4 x flat instance descriptor:
      CpApMySwc: upstream-reference=EcuSwComposition.CpCoApplication.CpApMySwc, ecu-extract-reference=COMPOSITIONTYPE.CpApMySwc
      CpSaDoorFrontRight: upstream-reference=EcuSwComposition.CpCoApplication.CpSaDoorFrontRight, ecu-extract-reference=COMPOSITIONTYPE.CpSaDoorFrontRight
      CpSaInteriorLight: upstream-reference=EcuSwComposition.CpCoApplication.CpSaInteriorLight, ecu-extract-reference=COMPOSITIONTYPE.CpSaInteriorLight
      CpSaDoorFrontLeft: upstream-reference=EcuSwComposition.CpCoApplication.CpSaDoorFrontLeft, ecu-extract-reference=COMPOSITIONTYPE.CpSaDoorFrontLeft
