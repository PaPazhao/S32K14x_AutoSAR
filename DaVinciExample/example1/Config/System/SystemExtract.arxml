AUTOSAR XML (schema 4-2-1)
# Copyright (c) 2018 Vector Informatik GmbH.
# License is restricted to the usage with CBD1800257 (D01) for MSR_Vector_SLP4.
# Please contact Vector Informatik whenever you need further information concerning the license conditions.
package /VehicleProject
  system System
package /Cluster
  can cluster CAN00: protocol-name=CAN  # AutoSAR_LED
    can physical channel CHNL: comm-connectors=CN_CAN00
package /ECU
  ecu instance LED
    can communication controller CT_CAN00
    can communication connector CN_CAN00: comm-controller=CT_CAN00
