AUTOSAR XML (schema 00044)
package /ECUCompositionTypes
  composition sw component type ECU_Composition
package /EndToEndProtections
  end to end protection set EndToEndProtectionSet
package /Systems
  system example1
    root-software-compositions:
      root sw composition prototype EcuSwComposition: software-composition=ECU_Composition
