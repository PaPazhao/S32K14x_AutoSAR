AUTOSAR XML (schema 00044)
package /ComponentTypes
  sensor actuator sw component type CtSaDoor
    behavior CtSaDoor_InternalBehavior: supports-multiple-instantiation=true
  swc implementation CtSaDoor_Implementation: behavior=CtSaDoor_InternalBehavior
