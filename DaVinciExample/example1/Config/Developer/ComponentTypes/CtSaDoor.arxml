AUTOSAR XML (schema 00044)
package /ComponentTypes
  sensor actuator sw component type CtSaDoor
    provide port PpDoorState: nonqueued-sender-com-spec{data-element=DeDoorState, init-value=constant-reference=CDoorClosed}, provided-interface=PiDoorState
    behavior CtSaDoor_InternalBehavior: data-type-mapping=DemoTypeMapping, supports-multiple-instantiation=true
  swc implementation CtSaDoor_Implementation: behavior=CtSaDoor_InternalBehavior
