AUTOSAR XML (schema 00044)
package /ComponentTypes
  composition sw component type CtCoApplication
    4 x component:
      CpApMySwc: type=CtApMySwc
      CpSaDoorFrontRight: type=CtSaDoor
      CpSaInteriorLight: type=CtSaInteriorLight
      CpSaDoorFrontLeft: type=CtSaDoor
    connect CpApMySwc.PpLightStateFront -> CpSaInteriorLight.PpLightState
    connect CpSaDoorFrontLeft.PpDoorState -> CpApMySwc.PpDoorStateFrontLeft
    connect CpSaDoorFrontRight.PpDoorState -> CpApMySwc.PpDoorStateFrontRight
