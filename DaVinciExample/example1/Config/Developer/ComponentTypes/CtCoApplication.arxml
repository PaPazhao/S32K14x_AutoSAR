AUTOSAR XML (schema 00044)
package /ComponentTypes
  composition sw component type CtCoApplication
