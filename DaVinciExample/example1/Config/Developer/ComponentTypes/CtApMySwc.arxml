AUTOSAR XML (schema 00044)
package /ComponentTypes
  application sw component type CtApMySwc
    behavior CtApMySwc_InternalBehavior
  swc implementation CtApMySwc_Implementation: behavior=CtApMySwc_InternalBehavior
