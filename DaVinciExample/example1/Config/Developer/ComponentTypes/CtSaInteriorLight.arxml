AUTOSAR XML (schema 00044)
package /ComponentTypes
  sensor actuator sw component type CtSaInteriorLight
    behavior CtSaInteriorLight_InternalBehavior: supports-multiple-instantiation=true
  swc implementation CtSaInteriorLight_Implementation: behavior=CtSaInteriorLight_InternalBehavior
