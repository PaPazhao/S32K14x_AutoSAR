AUTOSAR XML (schema 00044)
package /ComponentTypes
  sensor actuator sw component type CtSaInteriorLight
    require port PpLightState: nonqueued-receiver-com-spec{data-element=DeLightState, init-value=constant-reference=CLightOff}, required-interface=PiLightState
    behavior CtSaInteriorLight_InternalBehavior: data-type-mapping=DemoTypeMapping, supports-multiple-instantiation=true
  swc implementation CtSaInteriorLight_Implementation: behavior=CtSaInteriorLight_InternalBehavior
