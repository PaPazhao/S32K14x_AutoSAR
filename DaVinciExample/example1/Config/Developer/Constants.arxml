AUTOSAR XML (schema 00044)
package /Constants
  constant specification CDoorClosed: value-spec=0
  constant specification CLightOff: value-spec=0
