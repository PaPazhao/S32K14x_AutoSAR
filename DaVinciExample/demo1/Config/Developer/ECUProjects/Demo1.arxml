AUTOSAR XML (schema 00046)
package /ECUCompositionTypes
  composition sw component type ECU_Composition
    component CpCoApplication: type=CtCoApplication
package /EndToEndProtections
  end to end protection set EndToEndProtectionSet
package /Systems
  system Demo1
    root-software-compositions:
      root sw composition prototype EcuSwComposition: software-composition=ECU_Composition
