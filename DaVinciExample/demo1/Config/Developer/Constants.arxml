AUTOSAR XML (schema 00046)
package /Constants
  constant specification CDoorClosed: value-spec=0
  constant specification CLightOff: value-spec=0
