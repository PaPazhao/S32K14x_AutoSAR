AUTOSAR XML (schema 00046)
package /ComponentTypes
  composition sw component type CtCoApplication
    4 x component:
      CpApMySwc: type=CtApMySwc
      CpSaDoorFrontLeft: type=CtSaDoor
      CpSaDoorFrontRight: type=CtSaDoor
      CpSaInteriorLight: type=CtSaInteriorLight
    connect CpSaDoorFrontLeft.PpDoorState -> CpApMySwc.PpDoorStateFrontLeft
    connect CpSaDoorFrontRight.PpDoorState -> CpApMySwc.PpDoorStateFrontRight
    connect CpApMySwc.PpLightStateFront -> CpSaInteriorLight.PpLightState
