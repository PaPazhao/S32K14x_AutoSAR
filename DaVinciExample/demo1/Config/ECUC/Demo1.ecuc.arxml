AUTOSAR XML (schema 00047)
package /ActiveEcuC
  ecuc value collection ActiveEcuC
