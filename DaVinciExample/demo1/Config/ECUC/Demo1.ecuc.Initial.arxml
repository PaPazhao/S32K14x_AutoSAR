AUTOSAR XML (schema 00046)
package /InitialEcuC
  ecuc value collection InitialEcuC: ecuc-values=[Can, CanIf, CanSM, ComM, EcuM]
  module config Can
    CanConfigSet
      CT_CAN00_f3965de2 (CanController):
        CanControllerActivation = true
        CanControllerDefaultBaudrate = CanControllerBaudrateConfig
        CanControllerSystemRef = CT_CAN00
        CanWakeupSourceRef = EcuMCommonConfiguration/CN_CAN00_30389e62
        CanControllerBaudrateConfig
    CanGeneral: CanIndex=0
  module config CanIf
    CanIfCtrlDrvCfg_7d254554 (CanIfCtrlDrvCfg): CanIfCtrlDrvInitHohConfigRef=CanIfInitHohCfg, CanIfCtrlDrvNameRef=CanGeneral
      CT_CAN00_f3965de2 (CanIfCtrlCfg): CanIfCtrlCanCtrlRef=CanConfigSet/CT_CAN00_f3965de2
    CanIfInitCfg
      CanIfInitHohCfg: CanIfInitRefCfgSet=CanConfigSet
    CanIfPrivateCfg: CanIfPrivateSoftwareFilterType=LINEAR
    CanIfPublicCfg: CanIfPublicPnSupport=false
  module config CanSM
    CanSMConfiguration
      CHNL_0fb271d2 (CanSMManagerNetwork): CanSMComMNetworkHandleRef=ComMConfigSet/CN_CAN00_30389e62
        CT_CAN00_97828181 (CanSMController): CanSMControllerId=CanIfCtrlDrvCfg_7d254554/CT_CAN00_f3965de2
  module config ComM
    ComMConfigSet: ComMPncEnabled=false
      CN_CAN00_30389e62 (ComMChannel): ComMBusType=COMM_BUS_TYPE_CAN, ComMChannelId=0
        ComMNetworkManagement: ComMNmVariant=NONE
        CN_CAN00_8ffceba9 (ComMUserPerChannel): ComMUserChannel=CN_CAN00_5e8ba665
      CN_CAN00_5e8ba665 (ComMUser): ComMUserIdentifier=0
    ComMGeneral: ComMPncIdCounting=COMM_PNC_ID_COUNT_FROM_NM_MESSAGE, ComMPncSupport=false
  module config EcuM
    EcuMConfiguration
      EcuMCommonConfiguration
        EcuMDriverInitListOne
        EcuMDriverRestartList
        CN_CAN00_30389e62 (EcuMWakeupSource): EcuMWakeupSourceId=5, EcuMComMChannelRef=ComMConfigSet/CN_CAN00_30389e62
      EcuMFlexConfiguration: EcuMFlexModuleConfigurationRef=CanConfigSet
