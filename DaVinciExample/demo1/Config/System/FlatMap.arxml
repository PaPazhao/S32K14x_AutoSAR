AUTOSAR XML (schema 00046)
package /COM/VECTOR/CFG/WORKFLOW/SYSDESC/SYNC
  flat map FLATMAP
    4 x flat instance descriptor:
      CpApMySwc: upstream-reference=EcuSwComposition.CpCoApplication.CpApMySwc, ecu-extract-reference=COMPOSITIONTYPE.CpApMySwc
      CpSaDoorFrontLeft: upstream-reference=EcuSwComposition.CpCoApplication.CpSaDoorFrontLeft, ecu-extract-reference=COMPOSITIONTYPE.CpSaDoorFrontLeft
      CpSaDoorFrontRight: upstream-reference=EcuSwComposition.CpCoApplication.CpSaDoorFrontRight, ecu-extract-reference=COMPOSITIONTYPE.CpSaDoorFrontRight
      CpSaInteriorLight: upstream-reference=EcuSwComposition.CpCoApplication.CpSaInteriorLight, ecu-extract-reference=COMPOSITIONTYPE.CpSaInteriorLight
