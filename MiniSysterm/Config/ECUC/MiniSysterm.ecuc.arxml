AUTOSAR XML (schema 00045)
package /ActiveEcuC
  ecuc value collection ActiveEcuC: ecu-extract=SYSTEM, ecuc-values=[Base, Rte, vSet, EcuM, Os, BswM, Resource, Mcu, EcuC, Det]
