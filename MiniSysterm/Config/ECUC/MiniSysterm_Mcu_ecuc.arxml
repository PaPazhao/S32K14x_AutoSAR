AUTOSAR XML (schema 00045)
package /ActiveEcuC
  module config Mcu: implementation-config-variant=VARIANT-PRE-COMPILE, module-description=Mcu_Impl
    McuGeneralConfiguration:
      McuNoPll = false
      McuDevErrorDetect = false
      McuVersionInfoApi = false
      McuGetRamStateApi = false
      McuInitClock = true
      McuEnterLowPowerMode = true
      McuTimeout = 50000
      McuEnableUserModeSupport = false
      McuPerformResetApi = false
      McuCalloutBeforePerformReset = false
      McuPerformResetCallout = NULL_PTR
    McuDebugConfiguration: McuDisableDemReportErrorStatus=false, McuGetPeriphStateApi=false, McuGetMidrStructureApi=false, McuDisableCmuApi=false, McuEnablePeripheralCMU=false
    McuPublishedInformation
      McuResetReasonConf: McuResetReason=5
    CommonPublishedInformation:
      ArReleaseMajorVersion = 4
      ArReleaseMinorVersion = 2
      ArReleaseRevisionVersion = 2
      ModuleId = 101
      SwMajorVersion = 1
      SwMinorVersion = 0
      SwPatchVersion = 1
      VendorApiInfix = 
      VendorId = 43
    McuModuleConfiguration:
      McuNumberOfMcuModes = 1
      McuRamSectors = 1
      McuRTCCLKINFrequencyHz = 32000
      McuRtcClkSelect = SOSCDIV1_CLK
      McuLPOClockSelect = LPO_CLK_128K
      McuLPO32KClockEnable = true
      McuLPO1KClockEnable = true
      McuClockSrcFailureNotification = ENABLED
      McuAllowedModes: McuAllowHighSpeedRunMode=false, McuAllowVeryLowPowerModes=false
      McuSIMConfig
        McuChipControlConfiguration:
          McuEnableAdcSupplyMonitoring = false
          McuAdcSupply = VDD
          McuPDBBackToBackSelect = false
          McuPTB14InterleaveChannelSelect = false
          McuPTB13InterleaveChannelSelect = false
          McuPTB1InterleaveChannelSelect = false
          McuPTB0InterleaveChannelSelect = false
        McuFlexTimerConfiguration:
          McuFTM3ExternalClockPinSelect = TCLK0_PIN
          McuFTM2ExternalClockPinSelect = TCLK0_PIN
          McuFTM1ExternalClockPinSelect = TCLK0_PIN
          McuFTM0ExternalClockPinSelect = TCLK0_PIN
          McuFTM7ExternalClockPinSelect = TCLK0_PIN
          McuFTM6ExternalClockPinSelect = TCLK0_PIN
          McuFTM5ExternalClockPinSelect = TCLK0_PIN
          McuFTM4ExternalClockPinSelect = TCLK0_PIN
          McuFTM3Fault{0..2}Select = FTM3_FLT{0..2}_PIN
          McuFTM2Fault{0..2}Select = FTM2_FLT{0..2}_PIN
          McuFTM1Fault{0..2}Select = FTM1_FLT{0..2}_PIN
          McuFTM0Fault{0..2}Select = FTM0_FLT{0..2}_PIN
          McuFTM3Ch{0..7}ModulationSelect = false
          McuFTM0Ch{0..7}ModulationSelect = false
          McuFTM2Ch1InputSelect = FTM2_CHI1_INPUT
          McuFTM2Ch0InputSelect = FTM2_CH0_INPUT
          McuFTM1Ch0InputSelect = FTM1_CH0_INPUT
          McuFTMGlobalLoadEnable = false
          McuFTM7SyncBit = false
          McuFTM6SyncBit = false
          McuFTM5SyncBit = false
          McuFTM4SyncBit = false
          McuFTM3SyncBit = false
          McuFTM2SyncBit = false
          McuFTM1SyncBit = false
          McuFTM0SyncBit = false
          McuQspiClkSelect = false
          McuRMII_ClkSelect = false
          McuRMII_Clk_OBE = false
          McuFTM7OBEControl = false
          McuFTM6OBEControl = false
          McuFTM5OBEControl = false
          McuFTM4OBEControl = false
          McuFTM3OBEControl = false
          McuFTM2OBEControl = false
          McuFTM1OBEControl = false
          McuFTM0OBEControl = false
          McuFTM_GTBControl = false
        McuAdcOptionsConfiguration:
          McuADC1PreTrigeerSourceSelect = PDB_PRE_TRIGGER
          McuADC1SoftwarePreTrigeerSourceSelect = SW_PRE_TRIGGER_DISABLE
          McuADC1TrigeerSourceSelect = PDB
          McuADC0PreTrigeerSourceSelect = PDB_PRE_TRIGGER
          McuADC0SoftwarePreTrigeerSourceSelect = SW_PRE_TRIGGER_DISABLE
          McuADC0TrigeerSourceSelect = PDB
          McuSoftwareTriggerToTRGMUX = false
      McuClockSettingConfig: McuClockSettingId=0, McuSysClockUnderMcuControl=true, McuScgClkOutSelect=SCG_SLOW_CLK
        McuRunClockConfig:
          McuPreDivSystemClockFrequency = 48000000
          McuCoreClockFrequency = 48000000
          McuSystemClockFrequency = 80000000
          McuBusClockFrequency = 48000000
          McuFlashClockFrequency = 26670000
          McuSystemClockSwitch = FIRC
          McuCoreClockDivider = 1
          McuBusClockDivider = 1
          McuSlowClockDivider = 2
          McuScgClkOutFrequency = 1000000
        McuVlprClockConfig:
          McuPreDivSystemClockFrequency = 8000000
          McuCoreClockFrequency = 4000000
          McuSystemClockFrequency = 4000000
          McuBusClockFrequency = 4000000
          McuFlashClockFrequency = 1000000
          McuSystemClockSwitch = SIRC
          McuCoreClockDivider = 2
          McuBusClockDivider = 1
          McuSlowClockDivider = 4
          McuScgClkOutFrequency = 1000000
        McuHsrunClockConfig:
          McuPreDivSystemClockFrequency = 48000000
          McuCoreClockFrequency = 48000000
          McuSystemClockFrequency = 112000000
          McuBusClockFrequency = 56000000
          McuFlashClockFrequency = 28000000
          McuSystemClockSwitch = FIRC
          McuCoreClockDivider = 1
          McuBusClockDivider = 1
          McuSlowClockDivider = 2
          McuScgClkOutFrequency = 1000000
        McuSystemOSCClockConfig:
          McuSOSCUnderMcuControl = true
          McuSOSCFrequency = 8000000
          McuSOSCDiv2Frequency = 8000000
          McuSOSCDiv1Frequency = 8000000
          McuSOSCEnable = true
          McuSOSCClockMonitorResetEnable = false
          McuSOSCClockMonitorEnable = false
          McuSOSCDiv2 = 1
          McuSOSCDiv1 = 1
          McuSOSCRangeSelect = HIGH_FREQ_RANGE
          McuSOSCHighGainOscillatorSelect = false
          McuSOSCExternalReferenceSelect = false
        McuSIRCClockConfig:
          McuSIRCUnderMcuControl = true
          McuSIRCFrequency = 8000000
          McuSIRCDiv2Frequency = 4000000
          McuSIRCDiv1Frequency = 8000000
          McuSIRCEnable = true
          McuSIRCLowPowerEnable = false
          McuSIRCStopEnable = false
          McuSIRCDiv2 = 2
          McuSIRCDiv1 = 1
          McuSIRCRangeSelect = HIGH_RANGE_CLOCK
        McuFIRCClockConfig:
          McuFIRCUnderMcuControl = true
          McuFIRCFrequency = 48000000
          McuFIRCDiv2Frequency = 24000000
          McuFIRCDiv1Frequency = 48000000
          McuFIRCEnable = true
          McuFIRCRegulatorEnable = false
          McuFIRCDiv2 = 2
          McuFIRCDiv1 = 1
          McuFIRCRangeSelect = TRIMMED_TO_48MHZ
        McuSystemPll:
          McuSystemPllUnderMcuControl = false
          McuSPLLFrequency = 96000000
          McuSPLLDiv2Frequency = 48000000
          McuSPLLDiv1Frequency = 96000000
          McuSPLLEnable = false
          McuSPLLClockMonitorResetEnable = false
          McuSPLLClockMonitorEnable = false
          McuSPLLDiv2 = 2
          McuSPLLDiv1 = 1
          McuSPLLInputClkPreDivider = 1
          McuSPLLInputFrequency = 8000000
          McuSPLLMultiplier = 24
        McuSIMClockConfig:
          McuDebugTraceDividerEnable = true
          McuTraceClockDivider = 1
          McuTraceClockFraction = 0
          McuTraceClockSelect = CORE_CLK
          McuClockOutEnable = false
          McuClockOutDivider = 1
          McuClockOutSelect = SCG_CLKOUT
          McuEIMClockGatingEnable = true
          McuERMClockGatingEnable = true
          McuDMAClockGatingEnable = true
          McuMPUClockGatingEnable = true
          McuMSCMClockGatingEnable = true
          McuGPIOClockGatingEnable = false
        McuClkMonitor_0:
          McuClkMonitorEn = false
          McuFrequencyHigherInterrupt = false
          McuFrequencyLowerInterrupt = false
          McuReferenceCountConfiguration = 65535
          McuHighFrequencyRef = 16777215
          McuLowFrequencyRef = 0
        McuClkMonitor_1:
          McuClkMonitorEn = false
          McuFrequencyHigherInterrupt = false
          McuFrequencyLowerInterrupt = false
          McuReferenceCountConfiguration = 65535
          McuHighFrequencyRef = 16777215
          McuLowFrequencyRef = 0
        34 x McuPeripheralClockConfig, all with McuPerName=FTFC, McuPeripheralClockEnable=true, McuPeripheralClockSelect=EXT_CLK_OR_CLK_OFF, McuPeripheralClockDivider=1, McuPeripheralFractionalDivider=0, McuPeripheralClockFrequency=0:
          McuPeripheralClockConfig
          McuPeripheralClockConfig_{1..33}
        McuClockReferencePoint: McuClockReferencePointFrequency=48000000, McuClockFrequencySelect=RUN_SYS_CLK
      McuModeSettingConf: McuMode=0, McuPowerMode=RUN
      McuInterruptEvents: McuVoltageErrorEvent=false, McuAlternateResetEvent=false
      McuResetConfig: McuResetPinFilterBusClockSelect=0, McuResetPinFilterInStopMode=ALL_FILTERING_DISABLE, McuResetPinFilterInRunAndWait=ALL_FILTERING_DISABLE
        McuSystemInterruptEnable:
          McuResetDelayTime = DELAY_10_LPO_CYCLES
          McuStopAcknowledgeErrorInterrupt = false
          McuMDMAPSystemResetInterrupt = false
          McuSoftwareInterrupt = false
          McuCoreLockupInterrupt = false
          McuJTAGResetInterrupt = false
          McuGlobalInterrupt = false
          McuExternalResetPinInterrupt = false
          McuWatchdogInterrupt = false
          McuCMULossOfClockResetInterrupt = false
          McuLossOfLockInterrupt = false
          McuLossOfClockInterrupt = false
      McuPowerControl:
        McuLowVoltageDetectInterruptEnable = false
        McuLowVoltageDetectResetEnable = false
        McuLowVoltageWarningInterruptEnable = false
        McuLPODisable = false
        McuClockBiasDisable = false
        McuLowPowerBiasEnable = false
        McuLpoTrimming = 0
